## app/boards/jaykeeb/arble/Kconfig.arble
```kconfig
# SPDX-License-Identifier: MIT

config BOARD_ARBLE
	bool "arble"
	select SOC_NRF52840_QIAA
	imply RETAINED_MEM
	imply RETENTION
	imply RETENTION_BOOT_MODE

config BOARD_ENABLE_DCDC
	bool "Enable DCDC mode"
	select SOC_DCDC_NRF52X
	default y
	depends on BOARD_ARBLE
```

## app/boards/jaykeeb/arble_v2/Kconfig.arble_v2
```kconfig
# SPDX-License-Identifier: MIT

config BOARD_ARBLE_V2
    select SOC_NRF52840_QIAA
    imply RETAINED_MEM
    imply RETENTION
    imply RETENTION_BOOT_MODE
```

## app/boards/jaykeeb/rable40/rable40_defconfig
```kconfig
# SPDX-License-Identifier: MIT

CONFIG_ARM_MPU=y
CONFIG_GPIO=y
CONFIG_ZMK_SLEEP=y
CONFIG_ZMK_IDLE_SLEEP_TIMEOUT=900000
CONFIG_ZMK_PM_SOFT_OFF=y
CONFIG_USE_DT_CODE_PARTITION=y
CONFIG_MPU_ALLOW_FLASH_WRITE=y
CONFIG_NVS=y
CONFIG_SETTINGS_NVS=y
CONFIG_FLASH=y
CONFIG_FLASH_PAGE_LAYOUT=y
CONFIG_FLASH_MAP=y

CONFIG_EC11=y
CONFIG_EC11_TRIGGER_GLOBAL_THREAD=y
CONFIG_ZMK_RGB_UNDERGLOW=n
CONFIG_ZMK_EXT_POWER=n
CONFIG_BUILD_OUTPUT_UF2=y
CONFIG_ZMK_BLE_CLEAR_BONDS_ON_START=n
CONFIG_USB_HID_BOOT_PROTOCOL=y

# Studio over the board's USB CDC ACM interface and BLE.
CONFIG_ZMK_STUDIO=y
CONFIG_ZMK_STUDIO_LOCKING=n
CONFIG_USB_DEVICE_STACK=y
CONFIG_USB_CDC_ACM=y
CONFIG_SERIAL=y
CONFIG_UART_INTERRUPT_DRIVEN=y
CONFIG_UART_LINE_CTRL=y
```

## app/boards/jaykeeb/rable_v5_hotswap/Kconfig.rable_v5_hotswap
```kconfig
# Copyright (c) 2020 Pete Johanson
# SPDX-License-Identifier: MIT

config BOARD_RABLE_V5_HOTSWAP
    select SOC_NRF52840_QIAA
    imply RETAINED_MEM
    imply RETENTION
    imply RETENTION_BOOT_MODE
```

## app/boards/jaykeeb/tayo_v2/Kconfig.tayo_v2
```kconfig
# SPDX-License-Identifier: MIT

config BOARD_TAYO_V2
    select SOC_NRF52840_QIAA
```

## app/boards/jaykeeb/tayo_x/Kconfig.board
```kconfig
# Zaphod board configuration

# Copyright (c) 2020 Pete Johanson
# SPDX-License-Identifier: MIT

config BOARD_TAYO_X
	bool "tayo_x"
	depends on SOC_NRF52840_QIAA
```

## app/boards/jaykeeb/tayo_x/Kconfig.tayo_x
```kconfig
# Copyright (c) 2020 Pete Johanson
# SPDX-License-Identifier: MIT

config BOARD_TAYO_X
    select SOC_NRF52840_QIAA
    imply RETAINED_MEM
    imply RETENTION
    imply RETENTION_BOOT_MODE
```

## app/dts/bindings/behaviors/zmk,behavior-sensor-key-position.yaml
```yaml
# Copyright (c) 2026 The ZMK Contributors
# SPDX-License-Identifier: MIT

description: Forward a sensor rotation tap to a Studio-editable keymap position
compatible: "zmk,behavior-sensor-key-position"
include: zero_param.yaml
properties:
  position:
    type: int
    required: true
    description: Logical keymap position receiving the press and release events
```

## app/tayo_v2/Kconfig/Kconfig.modules
```kconfig
menu "nanopb (/Users/zacksupreme/Documents/Keyboard/Firmware/zmk/modules/lib/nanopb)"
osource "$(ZEPHYR_NANOPB_KCONFIG)"
config ZEPHYR_NANOPB_MODULE
	bool
	default y
endmenu
menu "pmw3610 (/Users/zacksupreme/Documents/Keyboard/Firmware/zmk/modules/drivers/pmw3610)"
osource "/Users/zacksupreme/Documents/Keyboard/Firmware/zmk/modules/drivers/pmw3610/Kconfig"
config ZEPHYR_PMW3610_MODULE
	bool
	default y
endmenu
menu "acpica (/Users/zacksupreme/Documents/Keyboard/Firmware/zmk/modules/lib/acpica)"
osource "$(ZEPHYR_ACPICA_KCONFIG)"
config ZEPHYR_ACPICA_MODULE
	bool
	default y
endmenu
menu "canopennode (/Users/zacksupreme/Documents/Keyboard/Firmware/zmk/modules/lib/canopennode)"
osource "$(ZEPHYR_CANOPENNODE_KCONFIG)"
config ZEPHYR_CANOPENNODE_MODULE
	bool
	default y
endmenu
menu "cmsis (/Users/zacksupreme/Documents/Keyboard/Firmware/zmk/modules/hal/cmsis)"
osource "$(ZEPHYR_CMSIS_KCONFIG)"
config ZEPHYR_CMSIS_MODULE
	bool
	default y
endmenu
menu "cmsis-dsp (/Users/zacksupreme/Documents/Keyboard/Firmware/zmk/modules/lib/cmsis-dsp)"
osource "$(ZEPHYR_CMSIS_DSP_KCONFIG)"
config ZEPHYR_CMSIS_DSP_MODULE
	bool
	default y
endmenu
menu "cmsis-nn (/Users/zacksupreme/Documents/Keyboard/Firmware/zmk/modules/lib/cmsis-nn)"
osource "$(ZEPHYR_CMSIS_NN_KCONFIG)"
config ZEPHYR_CMSIS_NN_MODULE
	bool
	default y
endmenu
menu "fatfs (/Users/zacksupreme/Documents/Keyboard/Firmware/zmk/modules/fs/fatfs)"
osource "$(ZEPHYR_FATFS_KCONFIG)"
config ZEPHYR_FATFS_MODULE
	bool
	default y
endmenu
menu "hal_ambiq (/Users/zacksupreme/Documents/Keyboard/Firmware/zmk/modules/hal/ambiq)"
osource "$(ZEPHYR_HAL_AMBIQ_KCONFIG)"
config ZEPHYR_HAL_AMBIQ_MODULE
	bool
	default y
endmenu
menu "hal_espressif (/Users/zacksupreme/Documents/Keyboard/Firmware/zmk/modules/hal/espressif)"
osource "/Users/zacksupreme/Documents/Keyboard/Firmware/zmk/modules/hal/espressif/zephyr/Kconfig"
config ZEPHYR_HAL_ESPRESSIF_MODULE
	bool
	default y
endmenu
menu "hal_ethos_u (/Users/zacksupreme/Documents/Keyboard/Firmware/zmk/modules/hal/ethos_u)"
osource "$(ZEPHYR_HAL_ETHOS_U_KCONFIG)"
config ZEPHYR_HAL_ETHOS_U_MODULE
	bool
	default y
endmenu
menu "hal_gigadevice (/Users/zacksupreme/Documents/Keyboard/Firmware/zmk/modules/hal/gigadevice)"
osource "$(ZEPHYR_HAL_GIGADEVICE_KCONFIG)"
config ZEPHYR_HAL_GIGADEVICE_MODULE
	bool
	default y
endmenu
menu "hal_nordic (/Users/zacksupreme/Documents/Keyboard/Firmware/zmk/modules/hal/nordic)"
osource "$(ZEPHYR_HAL_NORDIC_KCONFIG)"
config ZEPHYR_HAL_NORDIC_MODULE
	bool
	default y
endmenu
menu "hal_rpi_pico (/Users/zacksupreme/Documents/Keyboard/Firmware/zmk/modules/hal/rpi_pico)"
osource "$(ZEPHYR_HAL_RPI_PICO_KCONFIG)"
config ZEPHYR_HAL_RPI_PICO_MODULE
	bool
	default y
endmenu
menu "hal_telink (/Users/zacksupreme/Documents/Keyboard/Firmware/zmk/modules/hal/telink)"
osource "/Users/zacksupreme/Documents/Keyboard/Firmware/zmk/modules/hal/telink/Kconfig"
config ZEPHYR_HAL_TELINK_MODULE
	bool
	default y
endmenu
menu "liblc3 (/Users/zacksupreme/Documents/Keyboard/Firmware/zmk/modules/lib/liblc3)"
osource "$(ZEPHYR_LIBLC3_KCONFIG)"
config ZEPHYR_LIBLC3_MODULE
	bool
	default y
endmenu
menu "littlefs (/Users/zacksupreme/Documents/Keyboard/Firmware/zmk/modules/fs/littlefs)"
osource "$(ZEPHYR_LITTLEFS_KCONFIG)"
config ZEPHYR_LITTLEFS_MODULE
	bool
	default y
endmenu
menu "lvgl (/Users/zacksupreme/Documents/Keyboard/Firmware/zmk/modules/lib/gui/lvgl)"
osource "/Users/zacksupreme/Documents/Keyboard/Firmware/zmk/modules/lib/gui/lvgl/Kconfig"
config ZEPHYR_LVGL_MODULE
	bool
	default y
endmenu
menu "mbedtls (/Users/zacksupreme/Documents/Keyboard/Firmware/zmk/modules/crypto/mbedtls)"
osource "$(ZEPHYR_MBEDTLS_KCONFIG)"
config ZEPHYR_MBEDTLS_MODULE
	bool
	default y
endmenu
menu "percepio (/Users/zacksupreme/Documents/Keyboard/Firmware/zmk/modules/debug/percepio)"
osource "/Users/zacksupreme/Documents/Keyboard/Firmware/zmk/modules/debug/percepio/zephyr/Kconfig"
config ZEPHYR_PERCEPIO_MODULE
	bool
	default y
endmenu
menu "picolibc (/Users/zacksupreme/Documents/Keyboard/Firmware/zmk/modules/lib/picolibc)"
osource "/Users/zacksupreme/Documents/Keyboard/Firmware/zmk/modules/lib/picolibc/zephyr/Kconfig"
config ZEPHYR_PICOLIBC_MODULE
	bool
	default y
endmenu
menu "segger (/Users/zacksupreme/Documents/Keyboard/Firmware/zmk/modules/debug/segger)"
osource "$(ZEPHYR_SEGGER_KCONFIG)"
config ZEPHYR_SEGGER_MODULE
	bool
	default y
endmenu
menu "trusted-firmware-a (/Users/zacksupreme/Documents/Keyboard/Firmware/zmk/modules/tee/tf-a/trusted-firmware-a)"
osource "$(ZEPHYR_TRUSTED_FIRMWARE_A_KCONFIG)"
config ZEPHYR_TRUSTED_FIRMWARE_A_MODULE
	bool
	default y
endmenu
menu "uoscore-uedhoc (/Users/zacksupreme/Documents/Keyboard/Firmware/zmk/modules/lib/uoscore-uedhoc)"
osource "$(ZEPHYR_UOSCORE_UEDHOC_KCONFIG)"
config ZEPHYR_UOSCORE_UEDHOC_MODULE
	bool
	default y
endmenu
menu "zcbor (/Users/zacksupreme/Documents/Keyboard/Firmware/zmk/modules/lib/zcbor)"
osource "$(ZEPHYR_ZCBOR_KCONFIG)"
config ZEPHYR_ZCBOR_MODULE
	bool
	default y
endmenu
menu "module (/Users/zacksupreme/Documents/Keyboard/Firmware/zmk/app/module)"
osource "/Users/zacksupreme/Documents/Keyboard/Firmware/zmk/app/module/Kconfig"
config ZEPHYR_MODULE_MODULE
	bool
	default y
endmenu
```
