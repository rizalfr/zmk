## app/boards/arm/toyo/Kconfig.defconfig
```kconfig
# Copyright (c) 2020 Pete Johanson
# SPDX-License-Identifier: MIT

if BOARD_TOYO

config BOARD
	default "toyo"

config ZMK_KEYBOARD_NAME
	default "Toyo (Rable75)"

if USB

config USB_NRFX
	default y

config USB_DEVICE_STACK
	default y

endif # USB

config SPI
	default y

config BT_CTLR
	default BT

config ZMK_BLE
	default y

config ZMK_USB
	default y

config ZMK_BATTERY_VOLTAGE_DIVIDER
	default y

endif # BOARD_TOYO
```

## app/boards/arm/toyo_v2/Kconfig.board
```kconfig
# Zaphod board configuration

# Copyright (c) 2020 Pete Johanson
# SPDX-License-Identifier: MIT

config BOARD_TOYO_V2
	bool "toyo_v2"
	depends on SOC_NRF52840_QIAA
```

## app/boards/arm/yas62/Kconfig.board
```kconfig
# Zaphod board configuration

# Copyright (c) 2020 Pete Johanson
# SPDX-License-Identifier: MIT

config BOARD_YAS62
	bool "yas62"
	depends on SOC_NRF52840_QIAA
```

## app/boards/jaykeeb/arble_v2/Kconfig.board
```kconfig
# Zaphod board configuration

# Copyright (c) 2020 Pete Johanson
# SPDX-License-Identifier: MIT

config BOARD_ARBLE_V2
	bool "arble_v2"
	depends on SOC_NRF52840_QIAA
```

## app/boards/jaykeeb/nouen62/Kconfig.board
```kconfig
# Zaphod board configuration

# Copyright (c) 2020 Pete Johanson
# SPDX-License-Identifier: MIT

config BOARD_NOUEN62
	bool "nouen62"
	depends on SOC_NRF52840_QIAA
```

## app/boards/jaykeeb/rable65/Kconfig.board
```kconfig
# Zaphod board configuration

# Copyright (c) 2020 Pete Johanson
# SPDX-License-Identifier: MIT

config BOARD_RABLE65
	bool "rable65"
	depends on SOC_NRF52840_QIAA
```

## app/boards/jaykeeb/rable_v5_hotswap/Kconfig.board
```kconfig
# Zaphod board configuration

# Copyright (c) 2020 Pete Johanson
# SPDX-License-Identifier: MIT

config BOARD_RABLE_V5_HOTSWAP
	bool "rable_v5_hotswap"
	depends on SOC_NRF52840_QIAA
```

## app/boards/jaykeeb/rable_v5_solder/Kconfig.defconfig
```kconfig
# Copyright (c) 2021 Nick Winans
# SPDX-License-Identifier: MIT

if BOARD_RABLE_V5_SOLDER

config ZMK_KEYBOARD_NAME
    default "Rable V5s"

if USB_DEVICE_STACK

config USB_NRFX
    default y

endif # USB_DEVICE_STACK

config BT_CTLR
    default BT

endif # BOARD_RABLE_V5_SOLDER
```

## app/boards/jaykeeb/toyo/Kconfig.board
```kconfig
# Zaphod board configuration

# Copyright (c) 2020 Pete Johanson
# SPDX-License-Identifier: MIT

config BOARD_TOYO
	bool "toyo"
	depends on SOC_NRF52840_QIAA
```

## app/boards/jaykeeb/toyo_v2/Kconfig.defconfig
```kconfig
# Copyright (c) 2020 Pete Johanson
# SPDX-License-Identifier: MIT

if BOARD_TOYO_V2

config BOARD
	default "toyo_v2"

config ZMK_KEYBOARD_NAME
	default "Toyo V2"

if USB

config USB_NRFX
	default y

config USB_DEVICE_STACK
	default y

endif # USB

config SPI
	default y

config BT_CTLR
	default BT

config ZMK_BLE
	default y

config ZMK_USB
	default y

config ZMK_BATTERY_VOLTAGE_DIVIDER
	default y

endif # BOARD_TOYO_V2
```

## app/boards/shields/cornble/Kconfig.defconfig
```kconfig
if SHIELD_CORNBLE_LEFT

config ZMK_KEYBOARD_NAME
    default "Cornble"

config ZMK_SPLIT_ROLE_CENTRAL
    default y

endif

if SHIELD_CORNBLE_LEFT || SHIELD_CORNBLE_RIGHT

endif
```

## app/boards/shields/cornble/Kconfig.shield
```kconfig
# Copyright (c) 2020 Pete Johanson
# SPDX-License-Identifier: MIT

config SHIELD_CORNBLE_LEFT
    def_bool $(shields_list_contains,cornble_left)

config SHIELD_CORNBLE_RIGHT
    def_bool $(shields_list_contains,cornble_right)
```

## app/boards/shields/korba/Kconfig.shield
```kconfig
# Copyright (c) 2020 Pete Johanson
# SPDX-License-Identifier: MIT

config SHIELD_KORBA_LEFT
    def_bool $(shields_list_contains,korba_left)

config SHIELD_KORBA_RIGHT
    def_bool $(shields_list_contains,korba_right)
```

## app/dts/bindings/sensor/pixart,pmw3610-alt.yaml
```yaml
description: PixArt PMW3610 Low Power Laser Mouse Sensor w/o motion burst support

compatible: "pixart,pmw3610-alt"

include: spi-device.yaml

properties:
    irq-gpios:
      type: phandle-array
      required: true
      description: |
        The gpio interrupt ping.
        The pin is active low.

    cpi:
      type: int
      required: false
      default: 1200
      description: |
        Sensor CPI (Counts Per Inch).
        From 200 to 3200 cpi, step size is 200 cpi.
        Default is 1200 cpi.

    evt-type:
      type: int
      required: false
      default: 0
      description: |
        Input event type.
        Default is 0 (EV_SYN).
        See include/zephyr/dt-bindings/input/input-event-codes.h

    x-input-code:
      type: int
      required: false
      default: 0
      description: |
        Input event code for X axis.
        Default is 0 (REL_X).
        See include/zephyr/dt-bindings/input/input-event-codes.h

    y-input-code:
      type: int
      required: false
      default: 1
      description: |
        Input event code for Y axis.
        Default is 1 (REL_Y).
        See include/zephyr/dt-bindings/input/input-event-codes.h

    swap-xy:
      type: boolean
      required: false
      description: Swap X and Y axis.

    invert-x:
      type: boolean
      required: false
      description: Invert X axis.

    invert-y:
      type: boolean
      required: false
      description: Invert Y axis.

    force-awake:
      type: boolean
      required: false
      description: |
        Force the sensor to stay awake (RUN mode).
        This consumes more power but provides better responsiveness.

    force-awake-4ms-mode:
      type: boolean
      required: false
      description: |
        Force the sensor to use 4ms polling rate in RUN mode.
        Default is 8ms.
        This consumes more power but provides better responsiveness.
        Only effective when force-awake is enabled.

    smart-algorithm:
      type: boolean
      required: false
      description: |
        Enable the smart algorithm (datasheet feature) to improve tracking.

    run-downshift-time-ms:
      type: int
      required: false
      description: |
        Time (ms) in RUN mode before downshifting to REST1.
        Default is 128ms.

    rest1-downshift-time-ms:
      type: int
      required: false
      description: |
        Time (ms) in REST1 mode before downshifting to REST2.
        Default is 5000ms.

    rest2-downshift-time-ms:
      type: int
      required: false
      description: |
        Time (ms) in REST2 mode before downshifting to REST3.
        Default is 17000ms.
```

## app/rable/Kconfig/Kconfig.modules
```kconfig
menu "CANopenNode (/home/zacksupreme/Documents/Keyboards/zmk/modules/lib/canopennode)"
osource "$(ZEPHYR_CANOPENNODE_KCONFIG)"
config ZEPHYR_CANOPENNODE_MODULE
	bool
	default y
endmenu
menu "hal_gigadevice (/home/zacksupreme/Documents/Keyboards/zmk/modules/hal/gigadevice)"
osource "$(ZEPHYR_HAL_GIGADEVICE_KCONFIG)"
config ZEPHYR_HAL_GIGADEVICE_MODULE
	bool
	default y
endmenu
menu "hal_nordic (/home/zacksupreme/Documents/Keyboards/zmk/modules/hal/nordic)"
osource "$(ZEPHYR_HAL_NORDIC_KCONFIG)"
config ZEPHYR_HAL_NORDIC_MODULE
	bool
	default y
endmenu
menu "hal_rpi_pico (/home/zacksupreme/Documents/Keyboards/zmk/modules/hal/rpi_pico)"
osource "$(ZEPHYR_HAL_RPI_PICO_KCONFIG)"
config ZEPHYR_HAL_RPI_PICO_MODULE
	bool
	default y
endmenu
menu "lz4 (/home/zacksupreme/Documents/Keyboards/zmk/modules/lib/lz4)"
osource "$(ZEPHYR_LZ4_KCONFIG)"
config ZEPHYR_LZ4_MODULE
	bool
	default y
endmenu
menu "mbedtls (/home/zacksupreme/Documents/Keyboards/zmk/modules/crypto/mbedtls)"
osource "$(ZEPHYR_MBEDTLS_KCONFIG)"
config ZEPHYR_MBEDTLS_MODULE
	bool
	default y
endmenu
menu "nanopb (/home/zacksupreme/Documents/Keyboards/zmk/modules/lib/nanopb)"
osource "$(ZEPHYR_NANOPB_KCONFIG)"
config ZEPHYR_NANOPB_MODULE
	bool
	default y
endmenu
menu "tflite-micro (/home/zacksupreme/Documents/Keyboards/zmk/modules/lib/tflite-micro)"
osource "$(ZEPHYR_TFLITE_MICRO_KCONFIG)"
config ZEPHYR_TFLITE_MICRO_MODULE
	bool
	default y
endmenu
menu "TraceRecorder (/home/zacksupreme/Documents/Keyboards/zmk/modules/debug/TraceRecorder)"
osource "/home/zacksupreme/Documents/Keyboards/zmk/modules/debug/TraceRecorder/kernelports/Zephyr/Kconfig"
config ZEPHYR_TRACERECORDER_MODULE
	bool
	default y
endmenu
menu "zscilib (/home/zacksupreme/Documents/Keyboards/zmk/modules/lib/zscilib)"
osource "/home/zacksupreme/Documents/Keyboards/zmk/modules/lib/zscilib/Kconfig.zscilib"
config ZEPHYR_ZSCILIB_MODULE
	bool
	default y
endmenu
menu "drivers (/home/zacksupreme/Documents/Keyboards/zmk/app/drivers)"
osource "/home/zacksupreme/Documents/Keyboards/zmk/app/drivers/Kconfig"
config ZEPHYR_DRIVERS_MODULE
	bool
	default y
endmenu
```

## app/rable_v4/Kconfig/Kconfig.modules
```kconfig
menu "acpica (/Users/rizalfr/Documents/Keyboard/firmware/zmk/modules/lib/acpica)"
osource "$(ZEPHYR_ACPICA_KCONFIG)"
config ZEPHYR_ACPICA_MODULE
	bool
	default y
endmenu
menu "canopennode (/Users/rizalfr/Documents/Keyboard/firmware/zmk/modules/lib/canopennode)"
osource "$(ZEPHYR_CANOPENNODE_KCONFIG)"
config ZEPHYR_CANOPENNODE_MODULE
	bool
	default y
endmenu
menu "cmsis (/Users/rizalfr/Documents/Keyboard/firmware/zmk/modules/hal/cmsis)"
osource "$(ZEPHYR_CMSIS_KCONFIG)"
config ZEPHYR_CMSIS_MODULE
	bool
	default y
endmenu
menu "cmsis-dsp (/Users/rizalfr/Documents/Keyboard/firmware/zmk/modules/lib/cmsis-dsp)"
osource "$(ZEPHYR_CMSIS_DSP_KCONFIG)"
config ZEPHYR_CMSIS_DSP_MODULE
	bool
	default y
endmenu
menu "cmsis-nn (/Users/rizalfr/Documents/Keyboard/firmware/zmk/modules/lib/cmsis-nn)"
osource "$(ZEPHYR_CMSIS_NN_KCONFIG)"
config ZEPHYR_CMSIS_NN_MODULE
	bool
	default y
endmenu
menu "fatfs (/Users/rizalfr/Documents/Keyboard/firmware/zmk/modules/fs/fatfs)"
osource "$(ZEPHYR_FATFS_KCONFIG)"
config ZEPHYR_FATFS_MODULE
	bool
	default y
endmenu
menu "hal_ambiq (/Users/rizalfr/Documents/Keyboard/firmware/zmk/modules/hal/ambiq)"
osource "$(ZEPHYR_HAL_AMBIQ_KCONFIG)"
config ZEPHYR_HAL_AMBIQ_MODULE
	bool
	default y
endmenu
menu "hal_espressif (/Users/rizalfr/Documents/Keyboard/firmware/zmk/modules/hal/espressif)"
osource "/Users/rizalfr/Documents/Keyboard/firmware/zmk/modules/hal/espressif/zephyr/Kconfig"
config ZEPHYR_HAL_ESPRESSIF_MODULE
	bool
	default y
endmenu
menu "hal_ethos_u (/Users/rizalfr/Documents/Keyboard/firmware/zmk/modules/hal/ethos_u)"
osource "$(ZEPHYR_HAL_ETHOS_U_KCONFIG)"
config ZEPHYR_HAL_ETHOS_U_MODULE
	bool
	default y
endmenu
menu "hal_gigadevice (/Users/rizalfr/Documents/Keyboard/firmware/zmk/modules/hal/gigadevice)"
osource "$(ZEPHYR_HAL_GIGADEVICE_KCONFIG)"
config ZEPHYR_HAL_GIGADEVICE_MODULE
	bool
	default y
endmenu
menu "hal_nordic (/Users/rizalfr/Documents/Keyboard/firmware/zmk/modules/hal/nordic)"
osource "$(ZEPHYR_HAL_NORDIC_KCONFIG)"
config ZEPHYR_HAL_NORDIC_MODULE
	bool
	default y
endmenu
menu "hal_rpi_pico (/Users/rizalfr/Documents/Keyboard/firmware/zmk/modules/hal/rpi_pico)"
osource "$(ZEPHYR_HAL_RPI_PICO_KCONFIG)"
config ZEPHYR_HAL_RPI_PICO_MODULE
	bool
	default y
endmenu
menu "hal_telink (/Users/rizalfr/Documents/Keyboard/firmware/zmk/modules/hal/telink)"
osource "/Users/rizalfr/Documents/Keyboard/firmware/zmk/modules/hal/telink/Kconfig"
config ZEPHYR_HAL_TELINK_MODULE
	bool
	default y
endmenu
menu "liblc3 (/Users/rizalfr/Documents/Keyboard/firmware/zmk/modules/lib/liblc3)"
osource "$(ZEPHYR_LIBLC3_KCONFIG)"
config ZEPHYR_LIBLC3_MODULE
	bool
	default y
endmenu
menu "littlefs (/Users/rizalfr/Documents/Keyboard/firmware/zmk/modules/fs/littlefs)"
osource "$(ZEPHYR_LITTLEFS_KCONFIG)"
config ZEPHYR_LITTLEFS_MODULE
	bool
	default y
endmenu
menu "lvgl (/Users/rizalfr/Documents/Keyboard/firmware/zmk/modules/lib/gui/lvgl)"
osource "/Users/rizalfr/Documents/Keyboard/firmware/zmk/modules/lib/gui/lvgl/Kconfig"
config ZEPHYR_LVGL_MODULE
	bool
	default y
endmenu
menu "mbedtls (/Users/rizalfr/Documents/Keyboard/firmware/zmk/modules/crypto/mbedtls)"
osource "$(ZEPHYR_MBEDTLS_KCONFIG)"
config ZEPHYR_MBEDTLS_MODULE
	bool
	default y
endmenu
menu "percepio (/Users/rizalfr/Documents/Keyboard/firmware/zmk/modules/debug/percepio)"
osource "/Users/rizalfr/Documents/Keyboard/firmware/zmk/modules/debug/percepio/zephyr/Kconfig"
config ZEPHYR_PERCEPIO_MODULE
	bool
	default y
endmenu
menu "picolibc (/Users/rizalfr/Documents/Keyboard/firmware/zmk/modules/lib/picolibc)"
osource "/Users/rizalfr/Documents/Keyboard/firmware/zmk/modules/lib/picolibc/zephyr/Kconfig"
config ZEPHYR_PICOLIBC_MODULE
	bool
	default y
endmenu
menu "segger (/Users/rizalfr/Documents/Keyboard/firmware/zmk/modules/debug/segger)"
osource "$(ZEPHYR_SEGGER_KCONFIG)"
config ZEPHYR_SEGGER_MODULE
	bool
	default y
endmenu
menu "trusted-firmware-a (/Users/rizalfr/Documents/Keyboard/firmware/zmk/modules/tee/tf-a/trusted-firmware-a)"
osource "$(ZEPHYR_TRUSTED_FIRMWARE_A_KCONFIG)"
config ZEPHYR_TRUSTED_FIRMWARE_A_MODULE
	bool
	default y
endmenu
menu "uoscore-uedhoc (/Users/rizalfr/Documents/Keyboard/firmware/zmk/modules/lib/uoscore-uedhoc)"
osource "$(ZEPHYR_UOSCORE_UEDHOC_KCONFIG)"
config ZEPHYR_UOSCORE_UEDHOC_MODULE
	bool
	default y
endmenu
menu "zcbor (/Users/rizalfr/Documents/Keyboard/firmware/zmk/modules/lib/zcbor)"
osource "$(ZEPHYR_ZCBOR_KCONFIG)"
config ZEPHYR_ZCBOR_MODULE
	bool
	default y
endmenu
menu "module (/Users/rizalfr/Documents/Keyboard/firmware/zmk/app/module)"
osource "/Users/rizalfr/Documents/Keyboard/firmware/zmk/app/module/Kconfig"
config ZEPHYR_MODULE_MODULE
	bool
	default y
endmenu
```
