## app/boards/arm/arble/Kconfig.defconfig
```kconfig
# Copyright (c) 2020 Pete Johanson
# SPDX-License-Identifier: MIT

if BOARD_ARBLE

config BOARD
	default "arble"

config ZMK_KEYBOARD_NAME
	default "arble"

if USB

config USB_NRFX
	default y

config USB_DEVICE_STACK
	default y

endif # USB

config SPI
	default y

config BT_CTLR
	default BT

config ZMK_BLE
	default y

config ZMK_USB
	default y

config ZMK_BATTERY_VOLTAGE_DIVIDER
	default y

endif # BOARD_ARBLE
```

## app/boards/arm/arble_v2/arble_v2_defconfig
```kconfig
# SPDX-License-Identifier: MIT

CONFIG_SOC_SERIES_NRF52X=y
CONFIG_SOC_NRF52840_QIAA=y

# Enable MPU
CONFIG_ARM_MPU=y

# enable GPIO
CONFIG_GPIO=y

CONFIG_ZMK_SLEEP=y

CONFIG_LVGL_USE_THEME_MONO=y

CONFIG_USE_DT_CODE_PARTITION=y

CONFIG_MPU_ALLOW_FLASH_WRITE=y
CONFIG_NVS=y
CONFIG_SETTINGS_NVS=y
CONFIG_FLASH=y
CONFIG_FLASH_PAGE_LAYOUT=y
CONFIG_FLASH_MAP=y

# Enable Encoders
CONFIG_EC11=n
CONFIG_EC11_TRIGGER_GLOBAL_THREAD=n

# Enable underglow
CONFIG_ZMK_RGB_UNDERGLOW=y
CONFIG_WS2812_STRIP=y

# Allow toggling underglow without toggling external power
CONFIG_ZMK_RGB_UNDERGLOW_EXT_POWER=y

# Increase BLE power level
CONFIG_BT_CTLR_TX_PWR_PLUS_8=n

# Enable .uf2 build
CONFIG_BUILD_OUTPUT_UF2=y

# Turn on logging, and set ZMK logging to debug output
CONFIG_ZMK_USB_LOGGING=n

CONFIG_ZMK_BLE_CLEAR_BONDS_ON_START=n

# Sleep BLE
CONFIG_ZMK_SLEEP=y
CONFIG_ZMK_IDLE_SLEEP_TIMEOUT=900000

# Enable on BIOS
CONFIG_USB_HID_BOOT_PROTOCOL=y
```

## app/boards/arm/kibo/Kconfig.defconfig
```kconfig
# Copyright (c) 2020 Pete Johanson
# SPDX-License-Identifier: MIT

if BOARD_kibo

config BOARD
	default "kibo"

config ZMK_KEYBOARD_NAME
	default "Makibao"

if USB

config USB_NRFX
	default y

config USB_DEVICE_STACK
	default y

endif # USB

config SPI
	default y

config BT_CTLR
	default BT

config ZMK_BLE
	default y

config ZMK_USB
	default y

config ZMK_BATTERY_VOLTAGE_DIVIDER
	default y

endif # BOARD_kibo
```

## app/boards/arm/m7w/Kconfig.board
```kconfig
# Zaphod board configuration

# Copyright (c) 2020 Pete Johanson
# SPDX-License-Identifier: MIT

config BOARD_M7W
	bool "m7w"
	depends on SOC_NRF52840_QIAA
```

## app/boards/arm/m7w/Kconfig.defconfig
```kconfig
# Copyright (c) 2020 Pete Johanson
# SPDX-License-Identifier: MIT

if BOARD_M7W

config BOARD
	default "m7w"

config ZMK_KEYBOARD_NAME
	default "Rable V4 Solder"

if USB

config USB_NRFX
	default y

config USB_DEVICE_STACK
	default y

endif # USB

config SPI
	default y

config BT_CTLR
	default BT

config ZMK_BLE
	default y

config ZMK_USB
	default y

config ZMK_BATTERY_VOLTAGE_DIVIDER
	default y

endif # BOARD_M7W
```

## app/boards/arm/mayo/Kconfig.defconfig
```kconfig
# Copyright (c) 2020 Pete Johanson
# SPDX-License-Identifier: MIT

if BOARD_MAYO

config BOARD
	default "mayo"

config ZMK_KEYBOARD_NAME
	default "Mayo"

if USB

config USB_NRFX
	default y

config USB_DEVICE_STACK
	default y

endif # USB

config SPI
	default y

config BT_CTLR
	default BT

config ZMK_BLE
	default y

config ZMK_USB
	default y

config ZMK_BATTERY_VOLTAGE_DIVIDER
	default y

endif # BOARD_MAYO
```

## app/boards/arm/nouen62/Kconfig.board
```kconfig
# Copyright (c) 2021 Nick Winans
# SPDX-License-Identifier: MIT

config BOARD_NOUEN62
    bool "Nouen62"
    depends on SOC_NRF52840_QIAA
```

## app/boards/arm/rable/Kconfig.board
```kconfig
# Rable board configuration

# Copyright (c) 2021 Polarity Works
# SPDX-License-Identifier: MIT

config BOARD_RABLE_V5
    bool "Rable V5"
    depends on SOC_NRF52840_QIAA

config BOARD_RABLE_V5_HS
    bool "Rable V5 Hotswap"
    depends on SOC_NRF52840_QIAA
```

## app/boards/arm/rable/Kconfig.defconfig
```kconfig
# Copyright (c) 2021 Polarity Works
# SPDX-License-Identifier: MIT

if BOARD_RABLE_V5_HS || BOARD_RABLE_V5

config BOARD
    default "Rable"

if USB

config USB_NRFX
    default y

config USB_DEVICE_STACK
    default y

endif # USB

config BT_CTLR
    default BT

config ZMK_KEYBOARD_NAME
    default "Rable V5"

endif # BOARD_RABLE_V5
```

## app/boards/arm/rable40/Kconfig.board
```kconfig
# Zaphod board configuration

# Copyright (c) 2020 Pete Johanson
# SPDX-License-Identifier: MIT

config BOARD_RABLE40
	bool "RABLE40"
	depends on SOC_NRF52840_QIAA
```

## app/boards/arm/rable65/Kconfig.defconfig
```kconfig
# Copyright (c) 2020 Pete Johanson
# SPDX-License-Identifier: MIT

if BOARD_RABLE65

config BOARD
	default "rable65"

config ZMK_KEYBOARD_NAME
	default "Rable65"

if USB

config USB_NRFX
	default y

config USB_DEVICE_STACK
	default y

endif # USB

config SPI
	default y

config BT_CTLR
	default BT

config ZMK_BLE
	default y

config ZMK_USB
	default y

config ZMK_BATTERY_VOLTAGE_DIVIDER
	default y

endif # BOARD_RABLE65
```

## app/boards/arm/rable_tru_hhkb/Kconfig.board
```kconfig
# Zaphod board configuration

# Copyright (c) 2020 Pete Johanson
# SPDX-License-Identifier: MIT

config BOARD_RABLE_TRU_HHKB
	bool "rable_tru_hhkb"
	depends on SOC_NRF52840_QIAA
```

## app/boards/arm/rable_tru_hhkb/Kconfig.defconfig
```kconfig
# Copyright (c) 2020 Pete Johanson
# SPDX-License-Identifier: MIT

if BOARD_RABLE_TRU_HHKB

config BOARD
	default "rable_tru_hhkb"

config ZMK_KEYBOARD_NAME
	default "Rable Tru HHKB"

if USB

config USB_NRFX
	default y

config USB_DEVICE_STACK
	default y

endif # USB

config SPI
	default y

config BT_CTLR
	default BT

config ZMK_BLE
	default y

config ZMK_USB
	default y

config ZMK_BATTERY_VOLTAGE_DIVIDER
	default y

endif # BOARD_RABLE_TRU_HHKB
```

## app/boards/arm/rable_v2/Kconfig.board
```kconfig
# Zaphod board configuration

# Copyright (c) 2020 Pete Johanson
# SPDX-License-Identifier: MIT

config BOARD_RABLE_V2
	bool "rable_v2"
	depends on SOC_NRF52840_QIAA
```

## app/boards/arm/rable_v2/Kconfig.defconfig
```kconfig
# Copyright (c) 2020 Pete Johanson
# SPDX-License-Identifier: MIT

if BOARD_RABLE_V2

config BOARD
	default "rable_v2"

config ZMK_KEYBOARD_NAME
	default "Rable V2"

if USB

config USB_NRFX
	default y

config USB_DEVICE_STACK
	default y

endif # USB

config SPI
	default y

config BT_CTLR
	default BT

config ZMK_BLE
	default y

config ZMK_USB
	default y

config ZMK_BATTERY_VOLTAGE_DIVIDER
	default y

endif # BOARD_RABLE_V2
```

## app/boards/arm/rable_v2_hotswap/Kconfig.board
```kconfig
# Zaphod board configuration

# Copyright (c) 2020 Pete Johanson
# SPDX-License-Identifier: MIT

config BOARD_RABLE_V2_HOTSWAP
	bool "rable_v2_hotswap"
	depends on SOC_NRF52840_QIAA
```

## app/boards/arm/rable_v2_hotswap/Kconfig.defconfig
```kconfig
# Copyright (c) 2020 Pete Johanson
# SPDX-License-Identifier: MIT

if BOARD_RABLE_V2_HOTSWAP

config BOARD
	default "rable_v2_hotswap"

config ZMK_KEYBOARD_NAME
	default "Rable V2 Hotswap"

if USB

config USB_NRFX
	default y

config USB_DEVICE_STACK
	default y

endif # USB

config SPI
	default y

config BT_CTLR
	default BT

config ZMK_BLE
	default y

config ZMK_USB
	default y

config ZMK_BATTERY_VOLTAGE_DIVIDER
	default y

endif # BOARD_RABLE_V2_HOTSWAP
```

## app/boards/arm/rable_v2_hotswap_65plus/Kconfig.board
```kconfig
# Zaphod board configuration

# Copyright (c) 2020 Pete Johanson
# SPDX-License-Identifier: MIT

config BOARD_RABLE_V2_HOTSWAP_65PLUS_65PLUS
	bool "RABLE_V2_HOTSWAP_65PLUS_65PLUS_65plus"
	depends on SOC_NRF52840_QIAA
```

## app/boards/arm/rable_v2_tsangan/Kconfig.board
```kconfig
# Zaphod board configuration

# Copyright (c) 2020 Pete Johanson
# SPDX-License-Identifier: MIT

config BOARD_RABLE_V2_TSANGAN
	bool "rable_v2_tsangan"
	depends on SOC_NRF52840_QIAA
```

## app/boards/arm/rable_v4_hotswap/Kconfig.board
```kconfig
# Zaphod board configuration

# Copyright (c) 2020 Pete Johanson
# SPDX-License-Identifier: MIT

config BOARD_RABLE_V4_HOTSWAP
	bool "rable_v4_hotswap"
	depends on SOC_NRF52840_QIAA
```

## app/boards/arm/rable_v4_solder /Kconfig.board
```kconfig
# Zaphod board configuration

# Copyright (c) 2020 Pete Johanson
# SPDX-License-Identifier: MIT

config BOARD_RABLE_V4_SOLDER
	bool "rable_v4_solder"
	depends on SOC_NRF52840_QIAA
```

## app/boards/arm/rable_v4_solder/Kconfig.board
```kconfig
# Zaphod board configuration

# Copyright (c) 2020 Pete Johanson
# SPDX-License-Identifier: MIT

config BOARD_RABLE_V4
	bool "rable_v4"
	depends on SOC_NRF52840_QIAA
```

## app/boards/arm/rable_v5_solder/Kconfig.defconfig
```kconfig
# Copyright (c) 2020 Pete Johanson
# SPDX-License-Identifier: MIT

if BOARD_RABLE_V5_SOLDER

config BOARD
	default "rable_v5_solder"

config ZMK_KEYBOARD_NAME
	default "Rable60 V5s"

if USB

config USB_NRFX
	default y

config USB_DEVICE_STACK
	default y

endif # USB

config SPI
	default y

config BT_CTLR
	default BT

config ZMK_BLE
	default y

config ZMK_USB
	default y

config ZMK_BATTERY_VOLTAGE_DIVIDER
	default y

endif # BOARD_RABLE_V5_SOLDER
```

## app/boards/arm/tayo_v2/Kconfig.board
```kconfig
# Zaphod board configuration

# Copyright (c) 2020 Pete Johanson
# SPDX-License-Identifier: MIT

config BOARD_TAYO_v2
	bool "tayo_v2"
	depends on SOC_NRF52840_QIAA
```

## app/boards/arm/tayo_v2/Kconfig.defconfig
```kconfig
# Copyright (c) 2020 Pete Johanson
# SPDX-License-Identifier: MIT

if BOARD_TAYO_v2

config BOARD
	default "tayo_v2"

config ZMK_KEYBOARD_NAME
	default "Tayo (Rable88)"

if USB

config USB_NRFX
	default y

config USB_DEVICE_STACK
	default y

endif # USB

config SPI
	default y

config BT_CTLR
	default BT

config ZMK_BLE
	default y

config ZMK_USB
	default y

config ZMK_BATTERY_VOLTAGE_DIVIDER
	default y

endif # BOARD_TAYO_v2
```
