/*
 * Copyright (c) 2020 The ZMK Contributors
 *
 * SPDX-License-Identifier: MIT
 */

#include "quefrency.dtsi"

/ {
    /* This kscan is for the 60% left half without macro keys the
     * macro pad layout may require different column and row pins
     */
    kscan0: kscan {
        compatible = "zmk,kscan-gpio-matrix";
        label = "KSCAN";
        diode-direction = "col2row";

        // #define MATRIX_COL_PINS { F5, F6, F7, B1, B3, B2, B6, B5 }
        col-gpios
            = <&pro_micro 20 GPIO_ACTIVE_HIGH> // 2
            , <&pro_micro 19 GPIO_ACTIVE_HIGH> // 3
            , <&pro_micro 18 GPIO_ACTIVE_HIGH> // 4
            , <&pro_micro 15 GPIO_ACTIVE_HIGH> // 5
            , <&pro_micro 14 GPIO_ACTIVE_HIGH> // 6
            , <&pro_micro 16 GPIO_ACTIVE_HIGH> // 7
            , <&pro_micro 10 GPIO_ACTIVE_HIGH>  // 8
            , <&pro_micro 9 GPIO_ACTIVE_HIGH> // 1
            ;

        // #define MATRIX_ROW_PINS { F4, D4, D7, E6, B4, C6 }
        row-gpios
            = <&pro_micro 21 (GPIO_ACTIVE_HIGH | GPIO_PULL_DOWN)>
            , <&pro_micro 4 (GPIO_ACTIVE_HIGH | GPIO_PULL_DOWN)>
            , <&pro_micro 6 (GPIO_ACTIVE_HIGH | GPIO_PULL_DOWN)>
            , <&pro_micro 7 (GPIO_ACTIVE_HIGH | GPIO_PULL_DOWN)>
            , <&pro_micro 8 (GPIO_ACTIVE_HIGH | GPIO_PULL_DOWN)>
            ;
    };
};
